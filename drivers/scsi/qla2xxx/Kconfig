## drivers/scsi/qla2xxx/Kconfig
```kconfig
# SPDX-License-Identifier: GPL-2.0-only
config SCSI_QLA_FC
	tristate "QLogic QLA2XXX Fibre Channel Support"
	depends on PCI && SCSI
	depends on SCSI_FC_ATTRS
	depends on NVME_FC || !NVME_FC
	select FW_LOADER
	select BTREE
	help
	This qla2xxx driver supports all QLogic Fibre Channel
	PCI and PCIe host adapters.

	/*(DEBLOBBED)*/

config TCM_QLA2XXX
	tristate "TCM_QLA2XXX fabric module for QLogic 24xx+ series target mode HBAs"
	depends on SCSI_QLA_FC && TARGET_CORE
	depends on LIBFC
	select BTREE
	default n
	help
	Say Y here to enable the TCM_QLA2XXX fabric module for QLogic 24xx+ series target mode HBAs

if TCM_QLA2XXX
config TCM_QLA2XXX_DEBUG
	bool "TCM_QLA2XXX fabric module DEBUG mode for QLogic 24xx+ series target mode HBAs"
	default n
	help
	Say Y here to enable the TCM_QLA2XXX fabric module DEBUG for QLogic 24xx+ series target mode HBAs
	This will include code to enable the SCSI command jammer
endif
```
