// SPDX-License-Identifier: GPL-2.0-only

/dts-v1/;

#include "sm8250-samsung-common.dtsi"

/ {
	model = "Samsung Galaxy S20";
	compatible = "samsung,x1q", "qcom,sm8250";
	chassis-type = "handset";
};

&adsp {
	firmware-name = "/*(DEBLOBBED)*/";
	status = "okay";
};

&cdsp {
	firmware-name = "/*(DEBLOBBED)*/";
	status = "okay";
};

&slpi {
	firmware-name = "/*(DEBLOBBED)*/";
	status = "okay";
};
