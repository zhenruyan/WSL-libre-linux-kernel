// SPDX-License-Identifier: BSD-3-Clause
/*
 * Copyright (c) Qualcomm Technologies, Inc. and/or its subsidiaries.
 */

&qupv3_0 {
	firmware-name = "/*(DEBLOBBED)*/";

	status = "okay";
};

&uart0 {
	status = "okay";
};
