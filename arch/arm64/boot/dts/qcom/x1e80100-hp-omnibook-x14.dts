// SPDX-License-Identifier: BSD-3-Clause
/*
 * Copyright (c) 2023 Qualcomm Innovation Center, Inc. All rights reserved.
 * Copyright (c) 2024, Xilin Wu <wuxilin123@gmail.com>
 */

/dts-v1/;

#include "hamoa.dtsi"
#include "hamoa-pmics.dtsi"
#include "x1-hp-omnibook-x14.dtsi"

/ {
	model = "HP Omnibook X 14-fe0";
	compatible = "hp,omnibook-x14", "qcom,x1e80100";
	chassis-type = "laptop";
};

&gpu_zap_shader {
	firmware-name = "/*(DEBLOBBED)*/";
};

&remoteproc_adsp {
	firmware-name = "/*(DEBLOBBED)*/",
			"/*(DEBLOBBED)*/";

	status = "okay";
};

&remoteproc_cdsp {
	firmware-name = "/*(DEBLOBBED)*/",
			"/*(DEBLOBBED)*/";

	status = "okay";
};
